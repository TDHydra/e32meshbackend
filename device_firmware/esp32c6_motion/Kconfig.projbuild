## device_firmware/esp32c6_motion/Kconfig.projbuild
```kconfig
menu "ESP32-C6 Motion Sensor Configuration"

    config MOTION_SENSOR_GPIO
        int "Motion Sensor GPIO Pin"
        default 4
        range 0 48
        help
            GPIO pin number for motion sensor input (typically PIR sensor).
            Default: GPIO 4 (suitable for ESP32-C6)

    config MOTION_SENSOR_SENSITIVITY
        int "Motion Sensor Sensitivity (1-10)"
        default 5
        range 1 10
        help
            Sensitivity level for motion detection.
            1 = least sensitive, 10 = most sensitive
            Default: 5 (medium)

    config MOTION_COOLDOWN_MS
        int "Motion Cooldown Period (ms)"
        default 30000
        range 5000 300000
        help
            Minimum time between motion events (prevents false triggers).
            Minimum: 5000ms (5 seconds)
            Maximum: 300000ms (5 minutes)
            Default: 30000ms (30 seconds)

    config DISPLAY_ENABLED
        bool "Enable TFT Display"
        default y
        help
            Enable ST7789 TFT display for motion status visualization.

    config DISPLAY_WIDTH
        int "Display Width (pixels)"
        default 240
        depends on DISPLAY_ENABLED

    config DISPLAY_HEIGHT
        int "Display Height (pixels)"
        default 320
        depends on DISPLAY_ENABLED

    config DISPLAY_SPI_SCLK_GPIO
        int "Display SPI SCLK GPIO"
        default 6
        depends on DISPLAY_ENABLED
        help
            GPIO pin for SPI clock line.

    config DISPLAY_SPI_MOSI_GPIO
        int "Display SPI MOSI GPIO"
        default 7
        depends on DISPLAY_ENABLED
        help
            GPIO pin for SPI MOSI (Master Out, Slave In) line.

    config DISPLAY_SPI_MISO_GPIO
        int "Display SPI MISO GPIO"
        default 5
        depends on DISPLAY_ENABLED
        help
            GPIO pin for SPI MISO (Master In, Slave Out) line.

    config DISPLAY_SPI_CS_GPIO
        int "Display SPI Chip Select GPIO"
        default 8
        depends on DISPLAY_ENABLED
        help
            GPIO pin for SPI chip select.

    config DISPLAY_DC_GPIO
        int "Display Data/Command GPIO"
        default 9
        depends on DISPLAY_ENABLED
        help
            GPIO pin for Data/Command control line.

    config DISPLAY_RESET_GPIO
        int "Display Reset GPIO"
        default 10
        depends on DISPLAY_ENABLED
        help
            GPIO pin for display reset control.

    config DISPLAY_BACKLIGHT_GPIO
        int "Display Backlight GPIO"
        default 11
        depends on DISPLAY_ENABLED
        help
            GPIO pin for backlight control.

    config DISPLAY_BRIGHTNESS
        int "Display Brightness (0-100%)"
        default 100
        range 0 100
        depends on DISPLAY_ENABLED
        help
            Default display brightness level.

endmenu
```

## home_base_firmware/main/Kconfig.projbuild
```kconfig
menu "Home Base Configuration"

    config UNRAID_API_URL
        string "Unraid API URL"
        default "http://192.168.1.100:8000/logs/ingest"
        help
            The full URL for the log ingestion endpoint on the Unraid server.

    config ETHERNET_PHY_ADDRESS
        int "Ethernet PHY Address"
        default 1
        help
            Ethernet PHY address on the MDIO bus.
            IP101 typically uses address 1.

    config ESP_NOW_CHANNEL
        int "ESP-NOW Channel"
        default 1
        range 1 13
        help
            WiFi channel for ESP-NOW mesh communication.

    config HTTP_SERVER_PORT
        int "HTTP Server Port"
        default 80
        help
            Port for the HTTP server serving device config portal and API endpoints.

    config DEVICE_CONFIG_PORTAL_ENABLED
        bool "Enable Device Config Portal"
        default y
        help
            Enable serving device config portal on unconfigured devices at http://192.168.4.1

endmenu
```
